## drivers/loragw/Kconfig
```kconfig
menuconfig LORAGW
	bool "LORAGW"
	depends on SPI
	help
	  enable driver for LORAGW.
if LORAGW

module = LORAGW
module-str = loragw
source "subsys/logging/Kconfig.template.log_config"

config LORAGW_INIT_PRIORITY
	int "LoRa initialization priority"
	default 90
	help
	  System initialization priority for LoRa drivers.

endif
```

## drivers/sensor/bgt3001/Kconfig
```kconfig
# Copyright (c) 2021 G-Technologies Sdn. Bhd.
# SPDX-License-Identifier: Apache-2.0

config BGT3001
	bool "sensor"
	depends on UART_INTERRUPT_DRIVEN
	help
	  Enable driver for the BGT3001 Soil Sensor.

if BGT3001

config BGT3001_KEEP_MCU_AWAKE
	bool "Keep MCU awake while polling"
	depends on PM
	help
	  Keep MCU awake while polling for data. This is required for uart driver
	  that doesn't support wake up from stop mode.

endif # BGT3001
```

## drivers/sensor/hdx8agh/Kconfig
```kconfig
# Copyright (c) 2021 G-Technologies Sdn. Bhd.
# SPDX-License-Identifier: Apache-2.0

config HDX8AGH
	bool "8 Channel Current sensor"
	depends on UART_INTERRUPT_DRIVEN
	help
	  Enable driver for the HDX8AGH 8 Channel Current Sensor.

if HDX8AGH

config HDX8AGH_KEEP_MCU_AWAKE
	bool "Keep MCU awake while polling"
	depends on PM
	default n
	help
	  Keep MCU awake while polling for data. This is required for uart driver
	  that doesn't support wake up from stop mode.
endif # HDX8AGH
```

## drivers/sensor/jsymk163/Kconfig
```kconfig
config JSYMK163
	bool "8 Channel Current sensor"
	depends on UART_INTERRUPT_DRIVEN
	help
	  Enable driver for the HDX8AGH 8 Channel Current Sensor.

if JSYMK163

config HDX8AGH_KEEP_MCU_AWAKE
	bool "Keep MCU awake while polling"
	depends on PM
	default n
	help
	  Keep MCU awake while polling for data. This is required for uart driver
	  that doesn't support wake up from stop mode.
endif
```

## drivers/sensor/paw3335/Kconfig
```kconfig
menuconfig PAW33335
	bool "PAW33335 sensor"
	help
	  enable driver for pixart paw33335 cmos sensor.
if PAW33335
endif
```

## drivers/sensor/vmszs/Kconfig
```kconfig
# Copyright (c) 2021 G-Technologies Sdn. Bhd.
# SPDX-License-Identifier: Apache-2.0

config VMSZS
	bool "Winsen CO2 sensor"
	depends on UART_INTERRUPT_DRIVEN
	help
	  Enable driver for the VMSZS CO2 Sensor.

if VMSZS

config VMSZS_KEEP_MCU_AWAKE
	bool "Keep MCU awake while polling"
	depends on PM
	help
	  Keep MCU awake while polling for data. This is required for uart driver
	  that doesn't support wake up from stop mode.

endif # VMSZS
```

## dts/bindings/lora/semtech,sx1268.yaml
```yaml
# Copyright (c) 2021, Ilya Tagunov
# SPDX-License-Identifier: Apache-2.0

description: Semtech SX1268 LoRa Modem

compatible: "semtech,sx1268"

include: semtech,sx126x-base.yaml
```

## dts/bindings/sensor/huidkj,hdx8agh.yaml
```yaml
# Copyright (c) 2021 G-Technologies Sdn. Bhd.
# SPDX-License-Identifier: Apache-2.0

description: HUIDKJ HDX8AGH 8-channel Current Sensor

compatible: "huidkj,hdx8agh"

include: uart-device.yaml
```

## dts/bindings/sensor/jsy,mk163.yaml
```yaml
# Copyright (c) 2021 G-Technologies Sdn. Bhd.
# SPDX-License-Identifier: Apache-2.0

description: JSY-MK-163 1-channel Current Sensor

compatible: "jsy,mk163"

include: uart-device.yaml
```

## dts/bindings/sensor/pixart,paw3335d.yaml
```yaml
# Copyright (c) 2018, NXP
# SPDX-License-Identifier: Apache-2.0

description: PAW3335D CMOS  SPI SENSOR

compatible: "pixart,paw3335d"

include: spi-device.yaml

properties:
    int1-gpios:
      type: phandle-array
      required: false
      description: |
        The INT1 signal defaults to active high as produced by the
        sensor.  The property value should ensure the flags properly
        describe the signal that is presented to the driver.
```

## dts/bindings/sensor/vemsee,bgt3001.yaml
```yaml
# Copyright (c) 2021 G-Technologies Sdn. Bhd.
# SPDX-License-Identifier: Apache-2.0

description: Vemsee BGT3001 Soil NPK Sensor

compatible: "vemsee,bgt3001"

include: uart-device.yaml
```

## dts/bindings/sensor/vemsee,vmszs.yaml
```yaml
# Copyright (c) 2021 G-Technologies Sdn. Bhd.
# SPDX-License-Identifier: Apache-2.0

description: Vemsee VMS-ZS-BZ Sound Sensor

compatible: "vemsee,vmszs"

include: uart-device.yaml
```
