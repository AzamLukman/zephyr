## CMakeLists.txt
```
# Copyright (c) 2021 G-Technologies Sdn. Bhd.
# SPDX-License-Identifier: Apache-2.0


cmake_minimum_required(VERSION 3.20.0)
find_package(Zephyr REQUIRED HINTS $ENV{ZEPHYR_BASE})
project(jsymk163)

FILE(GLOB app_sources src/*.c)
target_sources(app PRIVATE ${app_sources})
```

## prj.conf
```kconfig
# CONFIG_STDOUT_CONSOLE=y
CONFIG_SERIAL=y
CONFIG_JSYMK163=y
# CONFIG_HDX8AGH=y
CONFIG_UART_INTERRUPT_DRIVEN=y
CONFIG_SENSOR=y
CONFIG_SHELL=y
CONFIG_LOG=y
CONFIG_CBPRINTF_FP_SUPPORT=y
```

## src/main.c
```c
/*
 * Copyright (c) 2021 G-Technologies Sdn. Bhd.
 *
 * SPDX-License-Identifier: Apache-2.0
 */

#include <zephyr.h>
#include <sys/printk.h>
#include <drivers/sensor.h>
#include <drivers/sensor/jsymk163.h>

void main(void)
{
	const struct device *dev = device_get_binding("MK-163");
	struct sensor_value val[4];
	// int ret;

	printk(" MK-163 1-Channel current  sensor application %s\n", dev->name);

	if (!dev) {
		printk("sensor: device not found.\n");
		return;
	}
	// printk("sensor: device found %s.\n",dev->name);
	while (1) {
	// sensor_sample_fetch(dev);


		if (sensor_channel_get(dev, SENSOR_CHAN_CURRENT_JSYMK163_3, val) != 0) {
			printk("sensor: channel get fail.\n");
			// return;
		}

		// sensor_channel_get(dev, SENSOR_CHAN_CURRENT_1, val);
		printk("Unit 1 Current reading:A:%.2f\tB:%.2f\tC:%.2f\tD:%.2f\n",
		       sensor_value_to_double(&val[0]), sensor_value_to_double(&val[1]),
		       sensor_value_to_double(&val[2]), sensor_value_to_double(&val[3]));
		k_msleep(1000);

	}
}
```
