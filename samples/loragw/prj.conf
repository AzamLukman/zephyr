## CMakeLists.txt
```
# SPDX-License-Identifier: Apache-2.0

cmake_minimum_required(VERSION 3.20.0)
find_package(Zephyr REQUIRED HINTS $ENV{ZEPHYR_BASE})
project(loragw)

target_sources(app PRIVATE src/main.c)
```

## prj.conf
```kconfig
CONFIG_GPIO=y
CONFIG_SHELL=y
CONFIG_SPI=y
CONFIG_LORAGW=y
CONFIG_DMA=n
CONFIG_SPI_STM32_DMA=n
CONFIG_TEST_RANDOM_GENERATOR=y
CONFIG_NEWLIB_LIBC=y
CONFIG_NEWLIB_LIBC_FLOAT_PRINTF=y
```

## src/main.c
```c
#include <zephyr.h>
#include <device.h>
#include <devicetree.h>
#include <drivers/gpio.h>
#include <drivers/sensor.h>

void main(void)
{
	const struct device *dev;

	dev = device_get_binding("LORAGW");
	if (dev == NULL) {
		printk("Could not obtain LORAGW device\n");
		return;
	}


	// if(dev == NULL){
		// printk("error %s",dev->name);
	// }
	// else
	// {
		printk("device connected %s",dev->name);


}
```
